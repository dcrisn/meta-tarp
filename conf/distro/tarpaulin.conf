## conf/distro/tarpaulin.conf
```bitbake
# Configuration for a full-featured modern distro.
# If you need a more basic customization starting point, use tarplite.conf
# instead.
require conf/distro/poky.conf

# Must set this here because poky-tiny unconditionally sets it
# to something else, but if the MACHINE is raspberrypi it will
# not compile unless the kernel-provider is linux-raspberrypi.
# so we selectively override only for that specific machine.
PREFERRED_PROVIDER_virtual/kernel:raspberrypi4-64 := "linux-raspberrypi"

DISTRO = "tarpaulin"
DISTRO_NAME = "Linux Distro with tarp tools"
DISTROOVERRIDES = "tarpaulin"
DISTRO_VERSION = "0.0.1"

INIT_MANAGER := "systemd"

PACKAGE_CLASSES := "package_rpm"

DISTRO_FEATURES:remove := "acl \
                           alsa \
                           pulseaudio \
                           nfc \
                           nfs \
                           opengl \
                           ppp \
                           selinux \
                           seccomp \ 
                           wayland \ 
                           x11 \
                           xattr \
                           argp \
                           bluetooth \
                           debuginfod \
                           ext2 \
                           pcmcia \
                           3g \
                           vfat \
                           ptest \
                           vulkan \
                           jailhouse \
                           gobject-introspection-data \
"

DISTRO_FEATURES:append = ' ipv4 ipv6 ipsec zeroconf'
DISTRO_FEATURES:append = ' overlayfs'
DISTRO_FEATURES:append = ' systemd systemd-resolved'
DISTRO_FEATURES:append = ' nfs'
DISTRO_FEATURES:append = ' bluetooth'
DISTRO_FEATURES:append = ' wifi'
DISTRO_FEATURES:append = ' pci'
DISTRO_FEATURES:append = ' usbhost usbgadget'
DISTRO_FEATURES:append = ' pam'

# lxc etc
DISTRO_FEATURES:append = ' virtualization'
```

## conf/distro/tarplite.conf
```bitbake
# Configuration for a minimal distro. Since this may serve as a bare-bones
# starting point, most things are removed. Busybox is used instead of
# the more fully-fledged coreutils, the busybox init instead of systemd,
# and so on.

require conf/distro/poky-tiny.conf

# Must set this here because poky-tiny unconditionally sets it
# to something else, but if the MACHINE is raspberrypi it will
# not compile unless the kernel-provider is linux-raspberrypi.
# so we selectively override only for that specific machine.
PREFERRED_PROVIDER_virtual/kernel:raspberrypi4-64 := "linux-raspberrypi"

DISTRO = "tarplite"
DISTRO_NAME = "Small Linux Distro with tarp tools"
DISTROOVERRIDES = "tarplite"
DISTRO_VERSION = "0.0.1"

INIT_MANAGER := "mdev-busybox"

KERNEL_FEATURES += "small"

PACKAGE_CLASSES := "package_ipk"

DISTRO_FEATURES:remove := "acl \
                           alsa \
                           pulseaudio \
                           ipsec \
                           ipv6 \
                           nfc \
                           nfs \
                           opengl \
                           ppp \
                           selinux \
                           seccomp \ 
                           systemd \
                           wayland \ 
                           x11 \
                           wifi \
                           xattr \
                           argp \
                           bluetooth \
                           debuginfod \
                           ext2 \
                           zeroconf \
                           pcmia \
                           3g \
                           vfat \
                           ptest \
                           vulkan \
                           jailhouse \
                           virtualization \
                           gobject-introspection-data \
"
```

## conf/layer.conf
```bitbake
# BBPATH: Adds the layer’s root directory to BitBake’s search path. Through
# the use of the BBPATH variable, BitBake locates class files (.bbclass),
# configuration files, and files that are included with include and require
# statements. For these cases, BitBake uses the first file that matches the
# name found in BBPATH. This is similar to the way the PATH variable is
# used for binaries. It is recommended, therefore, that you use unique
# class and configuration filenames in your custom layer.
BBPATH .= ":${LAYERDIR}:${LAYERDIR}/classes-global"

# BBFILES: Defines the location for all recipes in the layer.
BBFILES += "\
	${LAYERDIR}/recipes-*/*/*.bb \
	${LAYERDIR}/images/*.bb \
	${LAYERDIR}/recipes-*/*/*.bbappend \
	"

# BBFILE_COLLECTIONS: Establishes the current layer through a unique identifier
# that is used throughout the OpenEmbedded build system to refer to the layer.
# In this example, the identifier “tarp” is the representation for the
# container layer named “meta-tarp”.
BBFILE_COLLECTIONS += "tarp"

# BBFILE_PATTERN: Expands immediately during parsing to provide the directory
# of the layer.
BBFILE_PATTERN_tarp := "^${LAYERDIR}/"

# BBFILE_PRIORITY: Establishes a priority to use for recipes in the layer when
# the OpenEmbedded build finds recipes of the same name in different layers.
BBFILE_PRIORITY_tarp = "999"

# LAYERVERSION: Establishes a version number for the layer. You can use this
# version number to specify this exact version of the layer as a dependency
# when using the LAYERDEPENDS variable.
LAYERVERSION_tarp = "1"

# LAYERDEPENDS: Lists all layers on which this layer depends (if any).
LAYERDEPENDS_tarp  += "openembedded-layer"

# LAYERSERIES_COMPAT: Lists the Yocto Project releases for which the current
# version is compatible. This variable is a good way to indicate if your
# particular layer is current.
LAYERSERIES_COMPAT_tarp = "scarthgap"
```

## layers/meta-tarp-raspberrypi/conf/layer.conf
```bitbake
# Layer configuration for meta-fgh-p257 layer

# BBPATH: Adds the layer’s root directory to BitBake’s search path. Through
# the use of the BBPATH variable, BitBake locates class files (.bbclass),
# configuration files, and files that are included with include and require
# statements. For these cases, BitBake uses the first file that matches the
# name found in BBPATH. This is similar to the way the PATH variable is
# used for binaries. It is recommended, therefore, that you use unique
# class and configuration filenames in your custom layer.
BBPATH .= ":${LAYERDIR}:${LAYERDIR}/classes-global"

# BBFILES: Defines the location for all recipes in the layer.
BBFILES += "\
	${LAYERDIR}/recipes-*/*/*.bb \
	${LAYERDIR}/recipes-*/*/*.bbappend \
	"

# BBFILE_COLLECTIONS: Establishes the current layer through a unique identifier
# that is used throughout the OpenEmbedded build system to refer to the layer.
# In this example, the identifier “tarp-raspberrypi” is the representation
# for the container layer named “meta-tarp-raspberrypi”.
BBFILE_COLLECTIONS += "tarp-raspberrypi"

# BBFILE_PATTERN: Expands immediately during parsing to provide the directory
# of the layer.
BBFILE_PATTERN_tarp-raspberrypi := "^${LAYERDIR}/"

# BBFILE_PRIORITY: Establishes a priority to use for recipes in the layer when
# the OpenEmbedded build finds recipes of the same name in different layers.
BBFILE_PRIORITY_tarp-raspberrypi = "99"

# LAYERVERSION: Establishes a version number for the layer. You can use this
# version number to specify this exact version of the layer as a dependency
# when using the LAYERDEPENDS variable.
LAYERVERSION_tarp-raspberrypi = "1"

# LAYERDEPENDS: Lists all layers on which this layer depends (if any).
LAYERDEPENDS_tarp-raspberrypi += "raspberrypi"

# LAYERSERIES_COMPAT: Lists the Yocto Project releases for which the current
# version is compatible. This variable is a good way to indicate if your
# particular layer is current.
LAYERSERIES_COMPAT_tarp-raspberrypi = "scarthgap"
```

## layers/meta-tarp-raspberrypi/conf/machine/raspberrypi4-64.conf
```bitbake
MACHINE_FEATURES:remove += 'alsa'
MACHINE_FEATURES:remove += 'bluetooth'
MACHINE_FEATURES:remove += 'phone'
MACHINE_FEATURES:remove += 'screen'
MACHINE_FEATURES:remove += 'touchscreen'
MACHINE_FEATURES:remove += ' wifi'
```
